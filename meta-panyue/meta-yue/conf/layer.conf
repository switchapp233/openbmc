## meta-panyue/meta-yue/conf/layer.conf
```bitbake
# We have a conf and classes directory, add to BBPATH
BBPATH .= ":${LAYERDIR}"

# We have recipes-* directories, add to BBFILES
BBFILES += "${LAYERDIR}/recipes-*/*/*.bb \
            ${LAYERDIR}/recipes-*/*/*.bbappend"

BBFILE_COLLECTIONS += "yue-layer"
BBFILE_PATTERN_yue-layer := "^${LAYERDIR}/"
LAYERSERIES_COMPAT_yue-layer = "warrior zeus"
```

## meta-panyue/meta-yue/conf/machine/yue.conf
```bitbake
KMACHINE = "aspeed"
KERNEL_DEVICETREE = "${KMACHINE}-bmc-lenovo-hr855xg2.dtb"

UBOOT_MACHINE = "ast_g5_phy_config"

FLASH_SIZE = "32768"
require conf/machine/include/ast2500.inc
require conf/machine/include/obmc-bsp-common.inc


OBMC_MACHINE_FEATURES += "\
        obmc-phosphor-fan-mgmt \
        obmc-phosphor-chassis-mgmt \
        obmc-phosphor-flash-mgmt \
        obmc-host-ipmi \
        obmc-host-state-mgmt \
        obmc-chassis-state-mgmt \
        obmc-bmc-state-mgmt \
        "
PREFERRED_PROVIDER_virtual/obmc-host-ipmi-hw = "phosphor-ipmi-bt"
PREFERRED_PROVIDER_virtual/obmc-chassis-mgmt = "packagegroup-panyue-apps"
PREFERRED_PROVIDER_virtual/obmc-fan-mgmt = "packagegroup-panyue-apps"
PREFERRED_PROVIDER_virtual/obmc-flash-mgmt = "packagegroup-panyue-apps"
PREFERRED_PROVIDER_virtual/obmc-system-mgmt = "packagegroup-panyue-apps"
```
